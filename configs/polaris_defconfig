## configs/polaris_ipados17_bsd_init_diag_defconfig
```kconfig
# Diagnostic only: force a distinctive panic as soon as bsd_init is entered.
CONFIG_XNU_BUILD_ARCHIVES=y
CONFIG_XNU_SOURCE_CORECRYPTO14=y
CONFIG_XNU_SOURCE_PTHREAD=y
CONFIG_XNU_ARM_DT_PLATFORM=y
CONFIG_XNU_ARMCPU=y
CONFIG_XNU_NATIVE_ARCH_TIMER=y
CONFIG_XNU_NATIVE_PAN=y
CONFIG_XNU_TRUST_CACHE_RUNTIME=y
CONFIG_XNU_SOURCE_MOCKFS=y
CONFIG_XNU_DT_PANIC_REGION=y
CONFIG_XNU_CRYPTO_BOOTSTRAP="prelinked"
CONFIG_XNU_NATIVE_UFS=y
CONFIG_XNU_SHENG_PMGR=y
CONFIG_XNU_NATIVE_ADRENO=n
CONFIG_XNU_NATIVE_LEGACY_DISPLAY=n
CONFIG_XNU_ARMVIRT_PLATFORM=n
CONFIG_XNU_POLARIS_ALLOW_UNVERIFIED_ROOT=y
CONFIG_XNU_POLARIS_DIAG_BSD_INIT=y
```
